/*  Date            Author    			Why              jira
*/
/dts-v1/;

#include "s2_msm8952.dtsi"

/ {
	model = "Qualcomm Technologies, Inc. MSM8952 QRD SKUM";
	compatible = "qcom,msm8952-qrd-skum", "qcom,msm8952-qrd", "qcom,msm8952", "qcom,qrd";
	qcom,board-id= <0xb 0>;
};
