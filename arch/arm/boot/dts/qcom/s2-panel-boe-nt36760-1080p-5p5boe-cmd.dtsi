/*
 * Copyright (c) 2015, The Linux Foundation. All rights reserved.
 *
 * This program is free software; you can redistribute it and/or modify
 * it under the terms of the GNU General Public License version 2 and
 * only version 2 as published by the Free Software Foundation.
 *
 * This program is distributed in the hope that it will be useful,
 * but WITHOUT ANY WARRANTY; without even the implied warranty of
 * MERCHANTABILITY or FITNESS FOR A PARTICULAR PURPOSE.  See the
 * GNU General Public License for more details.
 */

/*---------------------------------------------------------------------------
 * This file is autogenerated file using gcdb parser. Please do not edit it.
 * Update input XML file to add a new entry or update variable in this file
 * VERSION = "1.0"
 *---------------------------------------------------------------------------*/

&mdss_mdp {
	dsi_boe_nt36760_fhd_cmd: qcom,mdss_dsi_boe_nt36760_fhd_5p5boe_cmd{
		qcom,mdss-dsi-panel-name = "boe nt36760 fhd cmd dsi panel";
		qcom,cont-splash-enabled;
		qcom,mdss-dsi-panel-supply = <3>;
		qcom,panel-supply-entries = <&dsi_panel_pwr_supply>;
		qcom,mdss-dsi-panel-controller = <&mdss_dsi0>;
		qcom,mdss-dsi-panel-type = "dsi_cmd_mode";
		qcom,mdss-dsi-panel-destination = "display_1";
		qcom,mdss-dsi-panel-framerate = <60>;
		qcom,mdss-dsi-panel-clockrate = <802000000>;
		qcom,mdss-dsi-virtual-channel-id = <0>;
		qcom,mdss-dsi-stream = <0>;
		qcom,mdss-dsi-panel-width = <1080>;
		qcom,mdss-dsi-panel-height = <1920>;
		qcom,mdss-dsi-h-front-porch = <40>;
		qcom,mdss-dsi-h-back-porch =  <20>;
		qcom,mdss-dsi-h-pulse-width = <8>;
		qcom,mdss-dsi-h-sync-skew = <0>;
		qcom,mdss-dsi-v-back-porch = <10>;
		qcom,mdss-dsi-v-front-porch = <8>;
		qcom,mdss-dsi-v-pulse-width = <2>;
		qcom,mdss-dsi-h-left-border = <0>;
		qcom,mdss-dsi-h-right-border = <0>;
		qcom,mdss-dsi-v-top-border = <0>;
		qcom,mdss-dsi-v-bottom-border = <0>;
		qcom,mdss-dsi-bpp = <24>;
		qcom,mdss-dsi-underflow-color = <0xff>;
		qcom,mdss-dsi-border-color = <0>;
		qcom,mdss-dsi-on-command = [
		23 01 00 00 00 00 02 FF 20
		23 01 00 00 00 00 02 FB 01
		23 01 00 00 00 00 02 00 01
		23 01 00 00 00 00 02 01 55
		23 01 00 00 00 00 02 02 40
		23 01 00 00 00 00 02 05 50
		23 01 00 00 00 00 02 06 19
		23 01 00 00 00 00 02 07 A8
		23 01 00 00 00 00 02 08 0C
		//23 01 00 00 00 00 02 11 19
		//23 01 00 00 00 00 02 12 19
		23 01 00 00 00 00 02 13 03
		23 01 00 00 00 00 02 14 4A
		23 01 00 00 00 00 02 15 12
		23 01 00 00 00 00 02 16 12
		23 01 00 00 00 00 02 0B AF
		23 01 00 00 00 00 02 0C AF
		23 01 00 00 00 00 02 0E B0
		23 01 00 00 00 00 02 0F AE
		23 01 00 00 00 00 02 30 0F
		23 01 00 00 00 00 02 44 b2
		23 01 00 00 00 00 02 45 8C
		23 01 00 00 00 00 02 46 81
		23 01 00 00 00 00 02 54 02
		23 01 00 00 00 00 02 55 01
		23 01 00 00 00 00 02 58 02
		23 01 00 00 00 00 02 59 00
		23 01 00 00 00 00 02 5A 00
		23 01 00 00 00 00 02 5B 00
		23 01 00 00 00 00 02 5C 81
		23 01 00 00 00 00 02 5D 81
		23 01 00 00 00 00 02 5E 01
		23 01 00 00 00 00 02 5F 00
		23 01 00 00 00 00 02 FF 20
		23 01 00 00 00 00 02 FB 01
		23 01 00 00 00 00 02 75 00
		23 01 00 00 00 00 02 76 00
		23 01 00 00 00 00 02 77 00
		23 01 00 00 00 00 02 78 10
		23 01 00 00 00 00 02 79 00
		23 01 00 00 00 00 02 7A 2D
		23 01 00 00 00 00 02 7B 00
		23 01 00 00 00 00 02 7C 46
		23 01 00 00 00 00 02 7D 00
		23 01 00 00 00 00 02 7E 5E
		23 01 00 00 00 00 02 7F 00
		23 01 00 00 00 00 02 80 72
		23 01 00 00 00 00 02 81 00
		23 01 00 00 00 00 02 82 85
		23 01 00 00 00 00 02 83 00
		23 01 00 00 00 00 02 84 97
		23 01 00 00 00 00 02 85 00
		23 01 00 00 00 00 02 86 A6
		23 01 00 00 00 00 02 87 00
		23 01 00 00 00 00 02 88 DB
		23 01 00 00 00 00 02 89 01
		23 01 00 00 00 00 02 8A 04
		23 01 00 00 00 00 02 8B 01
		23 01 00 00 00 00 02 8C 43
		23 01 00 00 00 00 02 8D 01
		23 01 00 00 00 00 02 8E 73
		23 01 00 00 00 00 02 8F 01
		23 01 00 00 00 00 02 90 BC
		23 01 00 00 00 00 02 91 01
		23 01 00 00 00 00 02 92 F4
		23 01 00 00 00 00 02 93 01
		23 01 00 00 00 00 02 94 F6
		23 01 00 00 00 00 02 95 02
		23 01 00 00 00 00 02 96 30
		23 01 00 00 00 00 02 97 02
		23 01 00 00 00 00 02 98 75
		23 01 00 00 00 00 02 99 02
		23 01 00 00 00 00 02 9A A4
		23 01 00 00 00 00 02 9B 02
		23 01 00 00 00 00 02 9C E2
		23 01 00 00 00 00 02 9D 03
		23 01 00 00 00 00 02 9E 06
		23 01 00 00 00 00 02 9F 03
		23 01 00 00 00 00 02 A0 3C
		23 01 00 00 00 00 02 A2 03
		23 01 00 00 00 00 02 A3 4B
		23 01 00 00 00 00 02 A4 03
		23 01 00 00 00 00 02 A5 5B
		23 01 00 00 00 00 02 A6 03
		23 01 00 00 00 00 02 A7 6D
		23 01 00 00 00 00 02 A9 03
		23 01 00 00 00 00 02 AA 81
		23 01 00 00 00 00 02 AB 03
		23 01 00 00 00 00 02 AC 99
		23 01 00 00 00 00 02 AD 03
		23 01 00 00 00 00 02 AE B5
		23 01 00 00 00 00 02 AF 03
		23 01 00 00 00 00 02 B0 CD
		23 01 00 00 00 00 02 B1 03
		23 01 00 00 00 00 02 B2 FF
		23 01 00 00 00 00 02 B3 00
		23 01 00 00 00 00 02 B4 00
		23 01 00 00 00 00 02 B5 00
		23 01 00 00 00 00 02 B6 10
		23 01 00 00 00 00 02 B7 00
		23 01 00 00 00 00 02 B8 2D
		23 01 00 00 00 00 02 B9 00
		23 01 00 00 00 00 02 BA 46
		23 01 00 00 00 00 02 BB 00
		23 01 00 00 00 00 02 BC 5E
		23 01 00 00 00 00 02 BD 00
		23 01 00 00 00 00 02 BE 72
		23 01 00 00 00 00 02 BF 00
		23 01 00 00 00 00 02 C0 85
		23 01 00 00 00 00 02 C1 00
		23 01 00 00 00 00 02 C2 97
		23 01 00 00 00 00 02 C3 00
		23 01 00 00 00 00 02 C4 A6
		23 01 00 00 00 00 02 C5 00
		23 01 00 00 00 00 02 C6 DB
		23 01 00 00 00 00 02 C7 01
		23 01 00 00 00 00 02 C8 04
		23 01 00 00 00 00 02 C9 01
		23 01 00 00 00 00 02 CA 43
		23 01 00 00 00 00 02 CB 01
		23 01 00 00 00 00 02 CC 73
		23 01 00 00 00 00 02 CD 01
		23 01 00 00 00 00 02 CE BC
		23 01 00 00 00 00 02 CF 01
		23 01 00 00 00 00 02 D0 F4
		23 01 00 00 00 00 02 D1 01
		23 01 00 00 00 00 02 D2 F6
		23 01 00 00 00 00 02 D3 02
		23 01 00 00 00 00 02 D4 30
		23 01 00 00 00 00 02 D5 02
		23 01 00 00 00 00 02 D6 75
		23 01 00 00 00 00 02 D7 02
		23 01 00 00 00 00 02 D8 A4
		23 01 00 00 00 00 02 D9 02
		23 01 00 00 00 00 02 DA E2
		23 01 00 00 00 00 02 DB 03
		23 01 00 00 00 00 02 DC 06
		23 01 00 00 00 00 02 DD 03
		23 01 00 00 00 00 02 DE 3C
		23 01 00 00 00 00 02 DF 03
		23 01 00 00 00 00 02 E0 4B
		23 01 00 00 00 00 02 E1 03
		23 01 00 00 00 00 02 E2 5B
		23 01 00 00 00 00 02 E3 03
		23 01 00 00 00 00 02 E4 6D
		23 01 00 00 00 00 02 E5 03
		23 01 00 00 00 00 02 E6 81
		23 01 00 00 00 00 02 E7 03
		23 01 00 00 00 00 02 E8 99
		23 01 00 00 00 00 02 E9 03
		23 01 00 00 00 00 02 EA B5
		23 01 00 00 00 00 02 EB 03
		23 01 00 00 00 00 02 EC CD
		23 01 00 00 00 00 02 ED 03
		23 01 00 00 00 00 02 EE FF
		23 01 00 00 00 00 02 EF 00
		23 01 00 00 00 00 02 F0 00
		23 01 00 00 00 00 02 F1 00
		23 01 00 00 00 00 02 F2 10
		23 01 00 00 00 00 02 F3 00
		23 01 00 00 00 00 02 F4 2D
		23 01 00 00 00 00 02 F5 00
		23 01 00 00 00 00 02 F6 46
		23 01 00 00 00 00 02 F7 00
		23 01 00 00 00 00 02 F8 5E
		23 01 00 00 00 00 02 F9 00
		23 01 00 00 00 00 02 FA 72
		23 01 00 00 00 00 02 FF 21
		23 01 00 00 00 00 02 FB 01
		23 01 00 00 00 00 02 00 00
		23 01 00 00 00 00 02 01 85
		23 01 00 00 00 00 02 02 00
		23 01 00 00 00 00 02 03 97
		23 01 00 00 00 00 02 04 00
		23 01 00 00 00 00 02 05 A6
		23 01 00 00 00 00 02 06 00
		23 01 00 00 00 00 02 07 DB
		23 01 00 00 00 00 02 08 01
		23 01 00 00 00 00 02 09 04
		23 01 00 00 00 00 02 0A 01
		23 01 00 00 00 00 02 0B 43
		23 01 00 00 00 00 02 0C 01
		23 01 00 00 00 00 02 0D 73
		23 01 00 00 00 00 02 0E 01
		23 01 00 00 00 00 02 0F BC
		23 01 00 00 00 00 02 10 01
		23 01 00 00 00 00 02 11 F4
		23 01 00 00 00 00 02 12 01
		23 01 00 00 00 00 02 13 F6
		23 01 00 00 00 00 02 14 02
		23 01 00 00 00 00 02 15 30
		23 01 00 00 00 00 02 16 02
		23 01 00 00 00 00 02 17 75
		23 01 00 00 00 00 02 18 02
		23 01 00 00 00 00 02 19 A4
		23 01 00 00 00 00 02 1A 02
		23 01 00 00 00 00 02 1B E2
		23 01 00 00 00 00 02 1C 03
		23 01 00 00 00 00 02 1D 06
		23 01 00 00 00 00 02 1E 03
		23 01 00 00 00 00 02 1F 3C
		23 01 00 00 00 00 02 20 03
		23 01 00 00 00 00 02 21 4B
		23 01 00 00 00 00 02 22 03
		23 01 00 00 00 00 02 23 5B
		23 01 00 00 00 00 02 24 03
		23 01 00 00 00 00 02 25 6D
		23 01 00 00 00 00 02 26 03
		23 01 00 00 00 00 02 27 81
		23 01 00 00 00 00 02 28 03
		23 01 00 00 00 00 02 29 99
		23 01 00 00 00 00 02 2A 03
		23 01 00 00 00 00 02 2B B5
		23 01 00 00 00 00 02 2D 03
		23 01 00 00 00 00 02 2F CD
		23 01 00 00 00 00 02 30 03
		23 01 00 00 00 00 02 31 FF
		23 01 00 00 00 00 02 32 00
		23 01 00 00 00 00 02 33 00
		23 01 00 00 00 00 02 34 00
		23 01 00 00 00 00 02 35 10
		23 01 00 00 00 00 02 36 00
		23 01 00 00 00 00 02 37 2D
		23 01 00 00 00 00 02 38 00
		23 01 00 00 00 00 02 39 46
		23 01 00 00 00 00 02 3A 00
		23 01 00 00 00 00 02 3B 5E
		23 01 00 00 00 00 02 3D 00
		23 01 00 00 00 00 02 3F 72
		23 01 00 00 00 00 02 40 00
		23 01 00 00 00 00 02 41 85
		23 01 00 00 00 00 02 42 00
		23 01 00 00 00 00 02 43 97
		23 01 00 00 00 00 02 44 00
		23 01 00 00 00 00 02 45 A6
		23 01 00 00 00 00 02 46 00
		23 01 00 00 00 00 02 47 DB
		23 01 00 00 00 00 02 48 01
		23 01 00 00 00 00 02 49 04
		23 01 00 00 00 00 02 4A 01
		23 01 00 00 00 00 02 4B 43
		23 01 00 00 00 00 02 4C 01
		23 01 00 00 00 00 02 4D 73
		23 01 00 00 00 00 02 4E 01
		23 01 00 00 00 00 02 4F BC
		23 01 00 00 00 00 02 50 01
		23 01 00 00 00 00 02 51 F4
		23 01 00 00 00 00 02 52 01
		23 01 00 00 00 00 02 53 F6
		23 01 00 00 00 00 02 54 02
		23 01 00 00 00 00 02 55 30
		23 01 00 00 00 00 02 56 02
		23 01 00 00 00 00 02 58 75
		23 01 00 00 00 00 02 59 02
		23 01 00 00 00 00 02 5A A4
		23 01 00 00 00 00 02 5B 02
		23 01 00 00 00 00 02 5C E2
		23 01 00 00 00 00 02 5D 03
		23 01 00 00 00 00 02 5E 06
		23 01 00 00 00 00 02 5F 03
		23 01 00 00 00 00 02 60 3C
		23 01 00 00 00 00 02 61 03
		23 01 00 00 00 00 02 62 4B
		23 01 00 00 00 00 02 63 03
		23 01 00 00 00 00 02 64 5B
		23 01 00 00 00 00 02 65 03
		23 01 00 00 00 00 02 66 6D
		23 01 00 00 00 00 02 67 03
		23 01 00 00 00 00 02 68 81
		23 01 00 00 00 00 02 69 03
		23 01 00 00 00 00 02 6A 99
		23 01 00 00 00 00 02 6B 03
		23 01 00 00 00 00 02 6C B5
		23 01 00 00 00 00 02 6D 03
		23 01 00 00 00 00 02 6E CD
		23 01 00 00 00 00 02 6F 03
		23 01 00 00 00 00 02 70 FF
		23 01 00 00 00 00 02 71 00
		23 01 00 00 00 00 02 72 00
		23 01 00 00 00 00 02 73 00
		23 01 00 00 00 00 02 74 10
		23 01 00 00 00 00 02 75 00
		23 01 00 00 00 00 02 76 2D
		23 01 00 00 00 00 02 77 00
		23 01 00 00 00 00 02 78 46
		23 01 00 00 00 00 02 79 00
		23 01 00 00 00 00 02 7A 5E
		23 01 00 00 00 00 02 7B 00
		23 01 00 00 00 00 02 7C 72
		23 01 00 00 00 00 02 7D 00
		23 01 00 00 00 00 02 7E 85
		23 01 00 00 00 00 02 7F 00
		23 01 00 00 00 00 02 80 97
		23 01 00 00 00 00 02 81 00
		23 01 00 00 00 00 02 82 A6
		23 01 00 00 00 00 02 83 00
		23 01 00 00 00 00 02 84 DB
		23 01 00 00 00 00 02 85 01
		23 01 00 00 00 00 02 86 04
		23 01 00 00 00 00 02 87 01
		23 01 00 00 00 00 02 88 43
		23 01 00 00 00 00 02 89 01
		23 01 00 00 00 00 02 8A 73
		23 01 00 00 00 00 02 8B 01
		23 01 00 00 00 00 02 8C BC
		23 01 00 00 00 00 02 8D 01
		23 01 00 00 00 00 02 8E F4
		23 01 00 00 00 00 02 8F 01
		23 01 00 00 00 00 02 90 F6
		23 01 00 00 00 00 02 91 02
		23 01 00 00 00 00 02 92 30
		23 01 00 00 00 00 02 93 02
		23 01 00 00 00 00 02 94 75
		23 01 00 00 00 00 02 95 02
		23 01 00 00 00 00 02 96 A4
		23 01 00 00 00 00 02 97 02
		23 01 00 00 00 00 02 98 E2
		23 01 00 00 00 00 02 99 03
		23 01 00 00 00 00 02 9A 06
		23 01 00 00 00 00 02 9B 03
		23 01 00 00 00 00 02 9C 3C
		23 01 00 00 00 00 02 9D 03
		23 01 00 00 00 00 02 9E 4B
		23 01 00 00 00 00 02 9F 03
		23 01 00 00 00 00 02 A0 5B
		23 01 00 00 00 00 02 A2 03
		23 01 00 00 00 00 02 A3 6D
		23 01 00 00 00 00 02 A4 03
		23 01 00 00 00 00 02 A5 81
		23 01 00 00 00 00 02 A6 03
		23 01 00 00 00 00 02 A7 99
		23 01 00 00 00 00 02 A9 03
		23 01 00 00 00 00 02 AA B5
		23 01 00 00 00 00 02 AB 03
		23 01 00 00 00 00 02 AC CD
		23 01 00 00 00 00 02 AD 03
		23 01 00 00 00 00 02 AE FF
		23 01 00 00 00 00 02 AF 00
		23 01 00 00 00 00 02 B0 00
		23 01 00 00 00 00 02 B1 00
		23 01 00 00 00 00 02 B2 10
		23 01 00 00 00 00 02 B3 00
		23 01 00 00 00 00 02 B4 2D
		23 01 00 00 00 00 02 B5 00
		23 01 00 00 00 00 02 B6 46
		23 01 00 00 00 00 02 B7 00
		23 01 00 00 00 00 02 B8 5E
		23 01 00 00 00 00 02 B9 00
		23 01 00 00 00 00 02 BA 72
		23 01 00 00 00 00 02 BB 00
		23 01 00 00 00 00 02 BC 85
		23 01 00 00 00 00 02 BD 00
		23 01 00 00 00 00 02 BE 97
		23 01 00 00 00 00 02 BF 00
		23 01 00 00 00 00 02 C0 A6
		23 01 00 00 00 00 02 C1 00
		23 01 00 00 00 00 02 C2 DB
		23 01 00 00 00 00 02 C3 01
		23 01 00 00 00 00 02 C4 04
		23 01 00 00 00 00 02 C5 01
		23 01 00 00 00 00 02 C6 43
		23 01 00 00 00 00 02 C7 01
		23 01 00 00 00 00 02 C8 73
		23 01 00 00 00 00 02 C9 01
		23 01 00 00 00 00 02 CA BC
		23 01 00 00 00 00 02 CB 01
		23 01 00 00 00 00 02 CC F4
		23 01 00 00 00 00 02 CD 01
		23 01 00 00 00 00 02 CE F6
		23 01 00 00 00 00 02 CF 02
		23 01 00 00 00 00 02 D0 30
		23 01 00 00 00 00 02 D1 02
		23 01 00 00 00 00 02 D2 75
		23 01 00 00 00 00 02 D3 02
		23 01 00 00 00 00 02 D4 A4
		23 01 00 00 00 00 02 D5 02
		23 01 00 00 00 00 02 D6 E2
		23 01 00 00 00 00 02 D7 03
		23 01 00 00 00 00 02 D8 06
		23 01 00 00 00 00 02 D9 03
		23 01 00 00 00 00 02 DA 3C
		23 01 00 00 00 00 02 DB 03
		23 01 00 00 00 00 02 DC 4B
		23 01 00 00 00 00 02 DD 03
		23 01 00 00 00 00 02 DE 5B
		23 01 00 00 00 00 02 DF 03
		23 01 00 00 00 00 02 E0 6D
		23 01 00 00 00 00 02 E1 03
		23 01 00 00 00 00 02 E2 81
		23 01 00 00 00 00 02 E3 03
		23 01 00 00 00 00 02 E4 99
		23 01 00 00 00 00 02 E5 03
		23 01 00 00 00 00 02 E6 B5
		23 01 00 00 00 00 02 E7 03
		23 01 00 00 00 00 02 E8 CD
		23 01 00 00 00 00 02 E9 03
		23 01 00 00 00 00 02 EA FF
		23 01 00 00 00 00 02 FF 24
		23 01 00 00 00 00 02 FB 01
		23 01 00 00 00 00 02 00 00
		23 01 00 00 00 00 02 01 01
		23 01 00 00 00 00 02 02 0B
		23 01 00 00 00 00 02 03 0C
		23 01 00 00 00 00 02 04 00
		23 01 00 00 00 00 02 05 03
		23 01 00 00 00 00 02 06 00
		23 01 00 00 00 00 02 07 04
		23 01 00 00 00 00 02 08 00
		23 01 00 00 00 00 02 09 00
		23 01 00 00 00 00 02 0A 00
		23 01 00 00 00 00 02 0B 00
		23 01 00 00 00 00 02 0C 00
		23 01 00 00 00 00 02 0D 17
		23 01 00 00 00 00 02 0E 15
		23 01 00 00 00 00 02 0F 13
		23 01 00 00 00 00 02 10 00
		23 01 00 00 00 00 02 11 01
		23 01 00 00 00 00 02 12 0B
		23 01 00 00 00 00 02 13 0C
		23 01 00 00 00 00 02 14 00
		23 01 00 00 00 00 02 15 03
		23 01 00 00 00 00 02 16 00
		23 01 00 00 00 00 02 17 04
		23 01 00 00 00 00 02 18 00
		23 01 00 00 00 00 02 19 00
		23 01 00 00 00 00 02 1A 00
		23 01 00 00 00 00 02 1B 00
		23 01 00 00 00 00 02 1C 00
		23 01 00 00 00 00 02 1D 17
		23 01 00 00 00 00 02 1E 15
		23 01 00 00 00 00 02 1F 13
		23 01 00 00 00 00 02 20 09
		23 01 00 00 00 00 02 21 02
		23 01 00 00 00 00 02 22 00
		23 01 00 00 00 00 02 23 01
		23 01 00 00 00 00 02 24 07
		23 01 00 00 00 00 02 25 3D
		23 01 00 00 00 00 02 26 01
		23 01 00 00 00 00 02 27 07
		23 01 00 00 00 00 02 29 38
		23 01 00 00 00 00 02 2A 2B
		23 01 00 00 00 00 02 2F 02
		23 01 00 00 00 00 02 30 01
		23 01 00 00 00 00 02 31 49
		23 01 00 00 00 00 02 32 23
		23 01 00 00 00 00 02 33 01
		23 01 00 00 00 00 02 34 02
		23 01 00 00 00 00 02 35 50
		23 01 00 00 00 00 02 36 00
		23 01 00 00 00 00 02 37 2D
		23 01 00 00 00 00 02 38 08
		23 01 00 00 00 00 02 39 02
		23 01 00 00 00 00 02 3A 50
		23 01 00 00 00 00 02 90 53
		23 01 00 00 00 00 02 7A 00
		23 01 00 00 00 00 02 7B A2
		23 01 00 00 00 00 02 7C D8
		23 01 00 00 00 00 02 7D 50
		23 01 00 00 00 00 02 74 02
		23 01 00 00 00 00 02 75 18
		23 01 00 00 00 00 02 76 02
		23 01 00 00 00 00 02 77 01
		23 01 00 00 00 00 02 81 02
		23 01 00 00 00 00 02 82 01
		23 01 00 00 00 00 02 84 02
		23 01 00 00 00 00 02 92 53
		23 01 00 00 00 00 02 D3 00
		23 01 00 00 00 00 02 D4 50
		23 01 00 00 00 00 02 2D 08
		23 01 00 00 00 00 02 7E 02
		23 01 00 00 00 00 02 7F 18
		23 01 00 00 00 00 02 78 00
		23 01 00 00 00 00 02 79 00
		23 01 00 00 00 00 02 80 00
		23 01 00 00 00 00 02 83 00
		23 01 00 00 00 00 02 85 01
		23 01 00 00 00 00 02 93 04
		23 01 00 00 00 00 02 8E 04
		23 01 00 00 00 00 02 94 04
		23 01 00 00 00 00 02 8F 04
		23 01 00 00 00 00 02 8A 33
		23 01 00 00 00 00 02 8B F0
		23 01 00 00 00 00 02 9B 0F
		23 01 00 00 00 00 02 9D B0
		23 01 00 00 00 00 02 B3 2A
		23 01 00 00 00 00 02 B4 2A
		23 01 00 00 00 00 02 B5 15
		23 01 00 00 00 00 02 E3 02
		23 01 00 00 00 00 02 FF 28
		23 01 00 00 00 00 02 FB 01
		23 01 00 00 00 00 02 61 80
		23 01 00 00 00 00 02 FF 2E
		23 01 00 00 00 00 02 FB 01
		23 01 00 00 00 00 02 00 AB
		23 01 00 00 00 00 02 04 06
		23 01 00 00 00 00 02 05 25
		23 01 00 00 00 00 02 06 30
		23 01 00 00 00 00 02 07 01
		23 01 00 00 00 00 02 09 00
		23 01 00 00 00 00 02 3F 05
		23 01 00 00 00 00 02 F8 06
		23 01 00 00 00 00 02 19 41
		23 01 00 00 00 00 02 1A 00
		23 01 00 00 00 00 02 1B 21
		23 01 00 00 00 00 02 20 1D
		23 01 00 00 00 00 02 21 21
		23 01 00 00 00 00 02 22 3E
		23 01 00 00 00 00 02 23 00
		23 01 00 00 00 00 02 48 1D
		23 01 00 00 00 00 02 49 00
		23 01 00 00 00 00 02 25 97
		23 01 00 00 00 00 02 26 80
		23 01 00 00 00 00 02 27 8C
		23 01 00 00 00 00 02 41 20
		23 01 00 00 00 00 02 42 00
		23 01 00 00 00 00 02 44 00
		23 01 00 00 00 00 02 46 12
		23 01 00 00 00 00 02 4C 01
		23 01 00 00 00 00 02 4D 19
		23 01 00 00 00 00 02 4E 01
		23 01 00 00 00 00 02 4F 17
		23 01 00 00 00 00 02 50 08
		23 01 00 00 00 00 02 51 C8
		23 01 00 00 00 00 02 53 1F
		23 01 00 00 00 00 02 54 3A
		23 01 00 00 00 00 02 55 40
		23 01 00 00 00 00 02 52 00
		23 01 00 00 00 00 02 2F 04
		23 01 00 00 00 00 02 30 70
		23 01 00 00 00 00 02 31 30
		23 01 00 00 00 00 02 32 BF
		23 01 00 00 00 00 02 33 1D
		23 01 00 00 00 00 02 34 20
		23 01 00 00 00 00 02 1E 9A
		23 01 00 00 00 00 02 0A 09
		23 01 00 00 00 00 02 0B 62
		23 01 00 00 00 00 02 0D 1b
		23 01 00 00 00 00 02 E1 2b
		23 01 00 00 00 00 02 E2 78
		23 01 00 00 00 00 02 E3 2b
		23 01 00 00 00 00 02 E4 78
		23 01 00 00 00 00 02 0E 01
		23 01 00 00 00 00 02 0F 05
		23 01 00 00 00 00 02 10 00
		23 01 00 00 00 00 02 12 08
		23 01 00 00 00 00 02 24 00
		23 01 00 00 00 00 02 31 00
		23 01 00 00 00 00 02 91 00
		23 01 00 00 00 00 02 96 01
		23 01 00 00 00 00 02 97 10
		23 01 00 00 00 00 02 98 42
		23 01 00 00 00 00 02 99 02
		23 01 00 00 00 00 02 9A 1E
		23 01 00 00 00 00 02 9B 03
		23 01 00 00 00 00 02 9C 01
		23 01 00 00 00 00 02 9D 01
		23 01 00 00 00 00 02 9E 01
		23 01 00 00 00 00 02 9F 02
		23 01 00 00 00 00 02 E0 A0
		23 01 00 00 00 00 02 AD 66
		23 01 00 00 00 00 02 B9 40
		23 01 00 00 00 00 02 BA 13
		23 01 00 00 00 00 02 BB 13
		23 01 00 00 00 00 02 BC 00
		23 01 00 00 00 00 02 BD 02
		23 01 00 00 00 00 02 BE 4F
		23 01 00 00 00 00 02 BF 50
		23 01 00 00 00 00 02 C0 58
		23 01 00 00 00 00 02 C3 02
		23 01 00 00 00 00 02 C4 01
		23 01 00 00 00 00 02 C5 03
		23 01 00 00 00 00 02 C6 15
		23 01 00 00 00 00 02 C7 49
		23 01 00 00 00 00 02 C8 0C
		23 01 00 00 00 00 02 C9 56
		23 01 00 00 00 00 02 CA 00
		23 01 00 00 00 00 02 CB 18
		23 01 00 00 00 00 02 CC 57
		23 01 00 00 00 00 02 CE 2F
		23 01 00 00 00 00 02 CF 00
		23 01 00 00 00 00 02 D0 B0
		23 01 00 00 00 00 02 D1 0A
		23 01 00 00 00 00 02 D2 0A
		23 01 00 00 00 00 02 FA 08
		23 01 00 00 00 00 02 FF E0
		23 01 00 00 00 00 02 FB 01
		23 01 00 00 00 00 02 A9 01

		23 01 00 00 00 00 02 FF 23
		23 01 00 00 00 00 02 FB 01
		23 01 00 00 00 00 02 00 20
		23 01 00 00 00 00 02 07 20
		23 01 00 00 00 00 02 08 01
		23 01 00 00 00 00 02 46 00

		23 01 00 00 00 00 02 FF 10
		23 01 00 00 00 00 02 FB 01
		39 01 00 00 00 00 04 3B 03 0A 0A
		23 01 00 00 00 00 02 35 00
		23 01 00 00 00 00 02 BB 10
		23 01 00 00 00 00 03 44 05 00
		39 01 00 00 00 00 0C C9 49 02 05 00 0F 06 67 03 2E 10 F0
		23 01 00 00 00 00 03 51 00 00
		23 01 00 00 00 00 02 55 03
		//23 01 00 00 00 00 02 FF 24
		//23 01 00 00 00 00 02 FB 01
		//23 01 00 00 00 00 02 EC 01
		05 01 00 00 78 00 02 11 00
		05 01 00 00 00 00 02 29 00
];

		qcom,mdss-dsi-off-command = [05 01 00 00 0A 00 02 28 00
					05 01 00 00 78 00 02 10 00];
		qcom,mdss-dsi-on-command-state = "dsi_lp_mode";
		qcom,mdss-dsi-off-command-state = "dsi_hs_mode";
		qcom,mdss-pan-physical-width-dimension = <69>;
		qcom,mdss-pan-physical-height-dimension = <122>;
		qcom,mdss-dsi-h-sync-pulse = <1>;
		qcom,mdss-dsi-traffic-mode = "burst_mode";
		qcom,mdss-dsi-lane-map = "lane_map_0123";
		qcom,mdss-dsi-bllp-eof-power-mode;
		qcom,mdss-dsi-bllp-power-mode;
		qcom,mdss-dsi-lp11-init;
		qcom,mdss-dsi-init-delay-us = <5>;
		qcom,mdss-dsi-lane-0-state;
		qcom,mdss-dsi-lane-1-state;
		qcom,mdss-dsi-lane-2-state;
		qcom,mdss-dsi-lane-3-state;
		qcom,mdss-dsi-te-pin-select = <1>;
		qcom,mdss-dsi-wr-mem-start = <0x2c>;
		qcom,mdss-dsi-te-dcs-command = <1>;
		qcom,mdss-dsi-te-check-enable;
		qcom,mdss-dsi-te-using-te-pin;
		//qcom,mdss-dsi-panel-timings = [E6 38 26 00 68 6E 2A 3C 2C 03 04 00];
		//qcom,mdss-dsi-t-clk-post = <0x2c>;
		//qcom,mdss-dsi-t-clk-pre = <0x2b>;
		qcom,mdss-dsi-panel-timings = [D5 32 22 00 60 64 26 36 29 03 04 00];
		qcom,mdss-dsi-t-clk-post = <0x2c>;
		qcom,mdss-dsi-t-clk-pre = <0x2b>;
		//qcom,esd-check-enabled;
		qcom,mdss-dsi-panel-status-command = [06 01 00 01 05 00 01 0A];
		qcom,mdss-dsi-panel-status-command-state = "dsi_hs_mode";
		qcom,mdss-dsi-panel-status-check-mode = "reg_read";
		qcom,mdss-dsi-panel-status-read-length=<1>;
		qcom,mdss-dsi-panel-status-value = <0x9C>;
		qcom,mdss-dsi-bl-pmic-pwm-frequency = <100>;
		qcom,mdss-dsi-bl-pmic-bank-select = <0>;
		qcom,mdss-dsi-dma-trigger = "trigger_sw";
		qcom,mdss-dsi-mdp-trigger = "none";
		qcom,mdss-dsi-bl-pmic-control-type = "bl_ctrl_dcs";
		qcom,mdss-dsi-bl-min-level = <0>;
		qcom,mdss-dsi-bl-max-level = <4095>;
		qcom,mdss-dsi-reset-sequence = <1 5>, <0 5>, <1 15>;
		qcom,mdss-dsi-post-init-delay = <5>;
	};
};
