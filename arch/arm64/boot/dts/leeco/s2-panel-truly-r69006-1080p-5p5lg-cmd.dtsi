/*
 * Copyright (c) 2015, The Linux Foundation. All rights reserved.
 *
 * This program is free software; you can redistribute it and/or modify
 * it under the terms of the GNU General Public License version 2 and
 * only version 2 as published by the Free Software Foundation.
 *
 * This program is distributed in the hope that it will be useful,
 * but WITHOUT ANY WARRANTY; without even the implied warranty of
 * MERCHANTABILITY or FITNESS FOR A PARTICULAR PURPOSE.  See the
 * GNU General Public License for more details.
 */

/*---------------------------------------------------------------------------
 * This file is autogenerated file using gcdb parser. Please do not edit it.
 * Update input XML file to add a new entry or update variable in this file
 * VERSION = "1.0"
 *---------------------------------------------------------------------------*/

&mdss_mdp {
	dsi_truly_r69006_fhd_cmd: qcom,mdss_dsi_truly_r69006_5p5lg_1080p_cmd {
		qcom,mdss-dsi-panel-name = "truly r69006 fhd cmd dsi panel";
		qcom,cont-splash-enabled;
		qcom,mdss-dsi-panel-supply = <2>;
		qcom,panel-supply-entries = <&dsi_panel_pwr_supply>;
		qcom,mdss-dsi-panel-controller = <&mdss_dsi0>;
		qcom,mdss-dsi-panel-type = "dsi_cmd_mode";
		qcom,mdss-dsi-panel-destination = "display_1";
		qcom,mdss-dsi-panel-framerate = <60>;
		qcom,mdss-dsi-panel-clockrate = <802000000>;
		qcom,mdss-dsi-virtual-channel-id = <0>;
		qcom,mdss-dsi-stream = <0>;
		qcom,mdss-dsi-panel-width = <1080>;
		qcom,mdss-dsi-panel-height = <1920>;
		qcom,mdss-dsi-h-front-porch = <40>;
		qcom,mdss-dsi-h-back-porch =  <20>;
		qcom,mdss-dsi-h-pulse-width = <8>;
		qcom,mdss-dsi-h-sync-skew = <0>;
		qcom,mdss-dsi-v-back-porch = <10>;
		qcom,mdss-dsi-v-front-porch = <8>;
		qcom,mdss-dsi-v-pulse-width = <2>;
		qcom,mdss-dsi-h-left-border = <0>;
		qcom,mdss-dsi-h-right-border = <0>;
		qcom,mdss-dsi-v-top-border = <0>;
		qcom,mdss-dsi-v-bottom-border = <0>;
		qcom,mdss-dsi-bpp = <24>;
		qcom,mdss-dsi-underflow-color = <0xff>;
		qcom,mdss-dsi-border-color = <0>;
		qcom,mdss-dsi-on-command = [
		23 01 00 00 00 00 02 B0 00
		29 01 00 00 00 00 06 B3 04 10 00 00 00
		29 01 00 00 00 00 03 B4 0c 00
		29 01 00 00 00 00 04 B6 3b d3 00
		23 01 00 00 00 00 02 C0 00
		15 01 00 00 00 00 02 36 98
		23 01 00 00 00 00 02 CC 04
		29 01 00 00 00 00 20 C1 84 00 10 EF 8B F1 FF FF DF 9C C5 9A 73 8D AD 63 FE FF FF CB F8 01 00 AA 40 00 C2 01 08 00 01
		29 01 00 00 00 00 0a CB 0D FE 1F 2C 00 00 00 00 00
		29 01 00 00 00 00 0b C2 01 F7 80 04 63 00 60 00 01 30
		29 01 00 00 00 00 07 C3 55 01 00 01 00 00
		29 01 00 00 00 00 12 C4 70 00 00 00 00 00 00 00 00 02 01 00 05 01 00 00 00
		29 01 00 00 00 00 0f C6 59 07 4a 07 4a 01 0E 01 02 01 02 09 15 07
		29 01 00 00 00 00 1f C7 00 13 1D 29 39 46 4F 5C 3F 46 51 5D 67 6D 7A 00 13 1D 29 39 46 4F 5C 3F 46 51 5D 67 6D 7A
		29 01 00 00 00 00 09 C9 1F 68 1F 68 4C 4C C4 11
		29 01 00 00 00 00 11 D0 33 01 91 0B D9 19 19 00 00 00 19 99 00 00 00 00
		29 01 00 00 00 00 1d D3 1B 3B BB AD A5 33 33 33 00 80 AD A8 5B 5B 33 33 33 F7 F2 1F 7D 7C FF 0F 99 00 FF FF
		29 01 00 00 00 00 04 D4 57 33 03
		29 01 00 00 00 00 0c D5 66 00 00 01 33 01 33 00 43 00 43
		29 01 00 00 00 00 02 BE 04
		29 01 00 00 00 00 11 CF 40 10 00 00 00 00 32 00 00 00 00 00 00 00 00 00
		29 01 00 00 00 00 06 DE 00 00 3F FF 10
		29 01 00 00 00 00 02 E9 00
		29 01 00 00 00 00 02 F2 00
		23 01 00 00 00 00 02 D6 01
		15 01 00 00 00 00 02 35 00
		29 01 00 00 00 00 18 CE 75 40 43 49 55 62 71 82 94 A8 B9 CB DB E9 F5 FC FF 05 00 22 05 00 24
		29 01 00 00 00 00 07 BA 03 70 81 20 45 B4
		//29 01 00 00 00 00 07 B9 07 82 3C 10 3C 87
		//29 01 00 00 00 00 07 B8 07 90 1E 10 1E 32
		39 01 00 00 00 00 02 51 00
		39 01 00 00 78 00 02 11 00
		39 01 00 00 1A 00 02 29 00
];

		qcom,mdss-dsi-off-command = [05 01 00 00 0A 00 02 28 00
					29 01 00 00 00 00 1d D3 13 3B BB A5 A5 33 33 33 00 80 A4 A8 37 33 33 33 33 F7 F2 1F 7D 7C FF 0F 99 00 FF FF
					05 01 00 00 5A 00 02 10 00];
		qcom,mdss-dsi-on-command-state = "dsi_lp_mode";
		qcom,mdss-dsi-off-command-state = "dsi_hs_mode";
		qcom,mdss-pan-physical-width-dimension = <69>;
		qcom,mdss-pan-physical-height-dimension = <122>;
		qcom,mdss-dsi-h-sync-pulse = <1>;
		qcom,mdss-dsi-traffic-mode = "burst_mode";
		qcom,mdss-dsi-lane-map = "lane_map_0123";
		qcom,mdss-dsi-bllp-eof-power-mode;
		qcom,mdss-dsi-bllp-power-mode;
		qcom,mdss-dsi-lp11-init;
		qcom,mdss-dsi-init-delay-us = <5>;
		qcom,mdss-dsi-lane-0-state;
		qcom,mdss-dsi-lane-1-state;
		qcom,mdss-dsi-lane-2-state;
		qcom,mdss-dsi-lane-3-state;
		qcom,mdss-dsi-te-pin-select = <1>;
		qcom,mdss-dsi-wr-mem-start = <0x2c>;
		qcom,mdss-dsi-te-dcs-command = <1>;
		qcom,mdss-dsi-te-check-enable;
		qcom,mdss-dsi-te-using-te-pin;
		//qcom,mdss-dsi-panel-timings = [E6 38 26 00 68 6E 2A 3C 2C 03 04 00];
		//qcom,mdss-dsi-t-clk-post = <0x2c>;
		//qcom,mdss-dsi-t-clk-pre = <0x2b>;
		qcom,mdss-dsi-panel-timings = [D5 32 22 00 60 64 26 36 29 03 04 00];
		qcom,mdss-dsi-t-clk-post = <0x2c>;
		qcom,mdss-dsi-t-clk-pre = <0x2b>;
		//qcom,esd-check-enabled;
		qcom,mdss-dsi-panel-status-command = [06 01 00 01 05 00 01 0A];
		qcom,mdss-dsi-panel-status-command-state = "dsi_hs_mode";
		qcom,mdss-dsi-panel-status-check-mode = "reg_read";
		qcom,mdss-dsi-panel-status-read-length=<1>;
		qcom,mdss-dsi-panel-status-value = <0x9C>;
		qcom,mdss-dsi-bl-pmic-pwm-frequency = <100>;
		qcom,mdss-dsi-bl-pmic-bank-select = <0>;
		qcom,mdss-dsi-dma-trigger = "trigger_sw";
		qcom,mdss-dsi-mdp-trigger = "none";
		qcom,mdss-dsi-bl-pmic-control-type = "bl_ctrl_dcs";
		qcom,mdss-dsi-bl-min-level = <0>;
		qcom,mdss-dsi-bl-max-level = <4095>;
		qcom,mdss-dsi-reset-sequence = <1 5>, <0 5>, <1 5>;
		qcom,mdss-dsi-post-init-delay = <5>;
	};
};
&ibb_regulator{
		qcom,qpnp-ibb-init-voltage = <5600000>;
		qcom,qpnp-ibb-init-lcd-voltage = <5600000>;
};
&lab_regulator{
		qcom,qpnp-lab-init-voltage = <5600000>;
		qcom,qpnp-lab-init-lcd-voltage = <5600000>;
};
