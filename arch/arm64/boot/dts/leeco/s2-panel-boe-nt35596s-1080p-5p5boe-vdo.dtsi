/*
 * Copyright (c) 2015, The Linux Foundation. All rights reserved.
 *
 * This program is free software; you can redistribute it and/or modify
 * it under the terms of the GNU General Public License version 2 and
 * only version 2 as published by the Free Software Foundation.
 *
 * This program is distributed in the hope that it will be useful,
 * but WITHOUT ANY WARRANTY; without even the implied warranty of
 * MERCHANTABILITY or FITNESS FOR A PARTICULAR PURPOSE.  See the
 * GNU General Public License for more details.
 */

/*---------------------------------------------------------------------------
 * This file is autogenerated file using gcdb parser. Please do not edit it.
 * Update input XML file to add a new entry or update variable in this file
 * VERSION = "1.0"
 *---------------------------------------------------------------------------*/

&mdss_mdp {
	dsi_boe_nt35596s_fhd_cmd: qcom,mdss_dsi_boe_nt35596s_fhd_5p5boe_vdo{
		qcom,mdss-dsi-panel-name = "boe nt35596s fhd vdo dsi panel";
		qcom,cont-splash-enabled;
		qcom,mdss-dsi-panel-supply = <1>;
		qcom,panel-supply-entries = <&dsi_panel_pwr_supply>;
		qcom,mdss-dsi-panel-controller = <&mdss_dsi0>;
		qcom,mdss-dsi-panel-type = "dsi_video_mode";
		qcom,mdss-dsi-panel-destination = "display_1";
		qcom,mdss-dsi-panel-framerate = <60>;
		qcom,mdss-dsi-virtual-channel-id = <0>;
		qcom,mdss-dsi-stream = <0>;
		qcom,mdss-dsi-panel-width = <1080>;
		qcom,mdss-dsi-panel-height = <1920>;
		qcom,mdss-dsi-h-front-porch = <40>;
		qcom,mdss-dsi-h-back-porch =  <20>;
		qcom,mdss-dsi-h-pulse-width = <8>;
		qcom,mdss-dsi-h-sync-skew = <0>;
		qcom,mdss-dsi-v-back-porch = <10>;
		qcom,mdss-dsi-v-front-porch = <8>;
		qcom,mdss-dsi-v-pulse-width = <2>;
		qcom,mdss-dsi-h-left-border = <0>;
		qcom,mdss-dsi-h-right-border = <0>;
		qcom,mdss-dsi-v-top-border = <0>;
		qcom,mdss-dsi-v-bottom-border = <0>;
		qcom,mdss-dsi-bpp = <24>;
		qcom,mdss-dsi-underflow-color = <0xff>;
		qcom,mdss-dsi-border-color = <0>;
		qcom,mdss-dsi-on-command = [
		23 01 00 00 00 00 02 FF F0
		23 01 00 00 00 00 02 FB 01
		23 01 00 00 00 00 02 E5 02
		23 01 00 00 00 00 02 FF 20
		23 01 00 00 00 00 02 FB 01
		23 01 00 00 00 00 02 30 0F
		23 01 00 00 00 00 02 01 55
		23 01 00 00 00 00 02 02 55
		23 01 00 00 00 00 02 05 50
		23 01 00 00 00 00 02 06 99
		23 01 00 00 00 00 02 07 A3
		//23 01 00 00 00 00 02 11 A1
		//23 01 00 00 00 00 02 12 A1
		23 01 00 00 00 00 02 13 00
		23 01 00 00 00 00 02 0B AF
		23 01 00 00 00 00 02 0C AF
		23 01 00 00 00 00 02 0E AB
		23 01 00 00 00 00 02 0F AE
		23 01 00 00 00 00 02 58 82
		23 01 00 00 00 00 02 59 02
		23 01 00 00 00 00 02 5A 00
		23 01 00 00 00 00 02 5B 02
		23 01 00 00 00 00 02 5C 82
		23 01 00 00 00 00 02 5D 82
		23 01 00 00 00 00 02 5E 00
		23 01 00 00 00 00 02 5F 02
		23 01 00 00 00 00 02 60 02
		23 01 00 00 00 00 02 61 02
		23 01 00 00 00 00 02 62 02
		23 01 00 00 00 00 02 63 02
		23 01 00 00 00 00 02 15 01
		23 01 00 00 00 00 02 44 72
		23 01 00 00 00 00 02 45 68
		23 01 00 00 00 00 02 46 81
		23 01 00 00 00 00 02 FF 20
		23 01 00 00 00 00 02 FB 01
		23 01 00 00 00 00 02 75 00
		23 01 00 00 00 00 02 76 00
		23 01 00 00 00 00 02 77 00
		23 01 00 00 00 00 02 78 0F
		23 01 00 00 00 00 02 79 00
		23 01 00 00 00 00 02 7A 2B
		23 01 00 00 00 00 02 7B 00
		23 01 00 00 00 00 02 7C 44
		23 01 00 00 00 00 02 7D 00
		23 01 00 00 00 00 02 7E 5A
		23 01 00 00 00 00 02 7F 00
		23 01 00 00 00 00 02 80 6F
		23 01 00 00 00 00 02 81 00
		23 01 00 00 00 00 02 82 81
		23 01 00 00 00 00 02 83 00
		23 01 00 00 00 00 02 84 92
		23 01 00 00 00 00 02 85 00
		23 01 00 00 00 00 02 86 A2
		23 01 00 00 00 00 02 87 00
		23 01 00 00 00 00 02 88 D5
		23 01 00 00 00 00 02 89 00
		23 01 00 00 00 00 02 8A FE
		23 01 00 00 00 00 02 8B 01
		23 01 00 00 00 00 02 8C 3C
		23 01 00 00 00 00 02 8D 01
		23 01 00 00 00 00 02 8E 6C
		23 01 00 00 00 00 02 8F 01
		23 01 00 00 00 00 02 90 B5
		23 01 00 00 00 00 02 91 01
		23 01 00 00 00 00 02 92 EF
		23 01 00 00 00 00 02 93 01
		23 01 00 00 00 00 02 94 F1
		23 01 00 00 00 00 02 95 02
		23 01 00 00 00 00 02 96 29
		23 01 00 00 00 00 02 97 02
		23 01 00 00 00 00 02 98 6C
		23 01 00 00 00 00 02 99 02
		23 01 00 00 00 00 02 9A 99
		23 01 00 00 00 00 02 9B 02
		23 01 00 00 00 00 02 9C D9
		23 01 00 00 00 00 02 9D 02
		23 01 00 00 00 00 02 9E FC
		23 01 00 00 00 00 02 9F 03
		23 01 00 00 00 00 02 A0 2F
		23 01 00 00 00 00 02 A2 03
		23 01 00 00 00 00 02 A3 41
		23 01 00 00 00 00 02 A4 03
		23 01 00 00 00 00 02 A5 53
		23 01 00 00 00 00 02 A6 03
		23 01 00 00 00 00 02 A7 66
		23 01 00 00 00 00 02 A9 03
		23 01 00 00 00 00 02 AA 7A
		23 01 00 00 00 00 02 AB 03
		23 01 00 00 00 00 02 AC 90
		23 01 00 00 00 00 02 AD 03
		23 01 00 00 00 00 02 AE A9
		23 01 00 00 00 00 02 AF 03
		23 01 00 00 00 00 02 B0 C7
		23 01 00 00 00 00 02 B1 03
		23 01 00 00 00 00 02 B2 D3
		23 01 00 00 00 00 02 B3 00
		23 01 00 00 00 00 02 B4 00
		23 01 00 00 00 00 02 B5 00
		23 01 00 00 00 00 02 B6 0F
		23 01 00 00 00 00 02 B7 00
		23 01 00 00 00 00 02 B8 2B
		23 01 00 00 00 00 02 B9 00
		23 01 00 00 00 00 02 BA 44
		23 01 00 00 00 00 02 BB 00
		23 01 00 00 00 00 02 BC 5A
		23 01 00 00 00 00 02 BD 00
		23 01 00 00 00 00 02 BE 6F
		23 01 00 00 00 00 02 BF 00
		23 01 00 00 00 00 02 C0 81
		23 01 00 00 00 00 02 C1 00
		23 01 00 00 00 00 02 C2 92
		23 01 00 00 00 00 02 C3 00
		23 01 00 00 00 00 02 C4 A2
		23 01 00 00 00 00 02 C5 00
		23 01 00 00 00 00 02 C6 D5
		23 01 00 00 00 00 02 C7 00
		23 01 00 00 00 00 02 C8 FE
		23 01 00 00 00 00 02 C9 01
		23 01 00 00 00 00 02 CA 3C
		23 01 00 00 00 00 02 CB 01
		23 01 00 00 00 00 02 CC 6C
		23 01 00 00 00 00 02 CD 01
		23 01 00 00 00 00 02 CE B5
		23 01 00 00 00 00 02 CF 01
		23 01 00 00 00 00 02 D0 EF
		23 01 00 00 00 00 02 D1 01
		23 01 00 00 00 00 02 D2 F1
		23 01 00 00 00 00 02 D3 02
		23 01 00 00 00 00 02 D4 29
		23 01 00 00 00 00 02 D5 02
		23 01 00 00 00 00 02 D6 6C
		23 01 00 00 00 00 02 D7 02
		23 01 00 00 00 00 02 D8 99
		23 01 00 00 00 00 02 D9 02
		23 01 00 00 00 00 02 DA D9
		23 01 00 00 00 00 02 DB 02
		23 01 00 00 00 00 02 DC FC
		23 01 00 00 00 00 02 DD 03
		23 01 00 00 00 00 02 DE 2F
		23 01 00 00 00 00 02 DF 03
		23 01 00 00 00 00 02 E0 41
		23 01 00 00 00 00 02 E1 03
		23 01 00 00 00 00 02 E2 53
		23 01 00 00 00 00 02 E3 03
		23 01 00 00 00 00 02 E4 66
		23 01 00 00 00 00 02 E5 03
		23 01 00 00 00 00 02 E6 7A
		23 01 00 00 00 00 02 E7 03
		23 01 00 00 00 00 02 E8 90
		23 01 00 00 00 00 02 E9 03
		23 01 00 00 00 00 02 EA A9
		23 01 00 00 00 00 02 EB 03
		23 01 00 00 00 00 02 EC C7
		23 01 00 00 00 00 02 ED 03
		23 01 00 00 00 00 02 EE D3
		23 01 00 00 00 00 02 EF 00
		23 01 00 00 00 00 02 F0 00
		23 01 00 00 00 00 02 F1 00
		23 01 00 00 00 00 02 F2 0F
		23 01 00 00 00 00 02 F3 00
		23 01 00 00 00 00 02 F4 2B
		23 01 00 00 00 00 02 F5 00
		23 01 00 00 00 00 02 F6 44
		23 01 00 00 00 00 02 F7 00
		23 01 00 00 00 00 02 F8 5A
		23 01 00 00 00 00 02 F9 00
		23 01 00 00 00 00 02 FA 6F
		23 01 00 00 00 00 02 FF 21
		23 01 00 00 00 00 02 FB 01
		23 01 00 00 00 00 02 00 00
		23 01 00 00 00 00 02 01 81
		23 01 00 00 00 00 02 02 00
		23 01 00 00 00 00 02 03 92
		23 01 00 00 00 00 02 04 00
		23 01 00 00 00 00 02 05 A2
		23 01 00 00 00 00 02 06 00
		23 01 00 00 00 00 02 07 D5
		23 01 00 00 00 00 02 08 00
		23 01 00 00 00 00 02 09 FE
		23 01 00 00 00 00 02 0A 01
		23 01 00 00 00 00 02 0B 3C
		23 01 00 00 00 00 02 0C 01
		23 01 00 00 00 00 02 0D 6C
		23 01 00 00 00 00 02 0E 01
		23 01 00 00 00 00 02 0F B5
		23 01 00 00 00 00 02 10 01
		23 01 00 00 00 00 02 11 EF
		23 01 00 00 00 00 02 12 01
		23 01 00 00 00 00 02 13 F1
		23 01 00 00 00 00 02 14 02
		23 01 00 00 00 00 02 15 29
		23 01 00 00 00 00 02 16 02
		23 01 00 00 00 00 02 17 6C
		23 01 00 00 00 00 02 18 02
		23 01 00 00 00 00 02 19 99
		23 01 00 00 00 00 02 1A 02
		23 01 00 00 00 00 02 1B D9
		23 01 00 00 00 00 02 1C 02
		23 01 00 00 00 00 02 1D FC
		23 01 00 00 00 00 02 1E 03
		23 01 00 00 00 00 02 1F 2F
		23 01 00 00 00 00 02 20 03
		23 01 00 00 00 00 02 21 41
		23 01 00 00 00 00 02 22 03
		23 01 00 00 00 00 02 23 53
		23 01 00 00 00 00 02 24 03
		23 01 00 00 00 00 02 25 66
		23 01 00 00 00 00 02 26 03
		23 01 00 00 00 00 02 27 7A
		23 01 00 00 00 00 02 28 03
		23 01 00 00 00 00 02 29 90
		23 01 00 00 00 00 02 2A 03
		23 01 00 00 00 00 02 2B A9
		23 01 00 00 00 00 02 2D 03
		23 01 00 00 00 00 02 2F C7
		23 01 00 00 00 00 02 30 03
		23 01 00 00 00 00 02 31 D3
		23 01 00 00 00 00 02 32 00
		23 01 00 00 00 00 02 33 00
		23 01 00 00 00 00 02 34 00
		23 01 00 00 00 00 02 35 0F
		23 01 00 00 00 00 02 36 00
		23 01 00 00 00 00 02 37 2B
		23 01 00 00 00 00 02 38 00
		23 01 00 00 00 00 02 39 44
		23 01 00 00 00 00 02 3A 00
		23 01 00 00 00 00 02 3B 5A
		23 01 00 00 00 00 02 3D 00
		23 01 00 00 00 00 02 3F 6F
		23 01 00 00 00 00 02 40 00
		23 01 00 00 00 00 02 41 81
		23 01 00 00 00 00 02 42 00
		23 01 00 00 00 00 02 43 92
		23 01 00 00 00 00 02 44 00
		23 01 00 00 00 00 02 45 A2
		23 01 00 00 00 00 02 46 00
		23 01 00 00 00 00 02 47 D5
		23 01 00 00 00 00 02 48 00
		23 01 00 00 00 00 02 49 FE
		23 01 00 00 00 00 02 4A 01
		23 01 00 00 00 00 02 4B 3C
		23 01 00 00 00 00 02 4C 01
		23 01 00 00 00 00 02 4D 6C
		23 01 00 00 00 00 02 4E 01
		23 01 00 00 00 00 02 4F B5
		23 01 00 00 00 00 02 50 01
		23 01 00 00 00 00 02 51 EF
		23 01 00 00 00 00 02 52 01
		23 01 00 00 00 00 02 53 F1
		23 01 00 00 00 00 02 54 02
		23 01 00 00 00 00 02 55 29
		23 01 00 00 00 00 02 56 02
		23 01 00 00 00 00 02 58 6C
		23 01 00 00 00 00 02 59 02
		23 01 00 00 00 00 02 5A 99
		23 01 00 00 00 00 02 5B 02
		23 01 00 00 00 00 02 5C D9
		23 01 00 00 00 00 02 5D 02
		23 01 00 00 00 00 02 5E FC
		23 01 00 00 00 00 02 5F 03
		23 01 00 00 00 00 02 60 2F
		23 01 00 00 00 00 02 61 03
		23 01 00 00 00 00 02 62 41
		23 01 00 00 00 00 02 63 03
		23 01 00 00 00 00 02 64 53
		23 01 00 00 00 00 02 65 03
		23 01 00 00 00 00 02 66 66
		23 01 00 00 00 00 02 67 03
		23 01 00 00 00 00 02 68 7A
		23 01 00 00 00 00 02 69 03
		23 01 00 00 00 00 02 6A 90
		23 01 00 00 00 00 02 6B 03
		23 01 00 00 00 00 02 6C A9
		23 01 00 00 00 00 02 6D 03
		23 01 00 00 00 00 02 6E C7
		23 01 00 00 00 00 02 6F 03
		23 01 00 00 00 00 02 70 D3
		23 01 00 00 00 00 02 71 00
		23 01 00 00 00 00 02 72 00
		23 01 00 00 00 00 02 73 00
		23 01 00 00 00 00 02 74 0F
		23 01 00 00 00 00 02 75 00
		23 01 00 00 00 00 02 76 2B
		23 01 00 00 00 00 02 77 00
		23 01 00 00 00 00 02 78 44
		23 01 00 00 00 00 02 79 00
		23 01 00 00 00 00 02 7A 5A
		23 01 00 00 00 00 02 7B 00
		23 01 00 00 00 00 02 7C 6F
		23 01 00 00 00 00 02 7D 00
		23 01 00 00 00 00 02 7E 81
		23 01 00 00 00 00 02 7F 00
		23 01 00 00 00 00 02 80 92
		23 01 00 00 00 00 02 81 00
		23 01 00 00 00 00 02 82 A2
		23 01 00 00 00 00 02 83 00
		23 01 00 00 00 00 02 84 D5
		23 01 00 00 00 00 02 85 00
		23 01 00 00 00 00 02 86 FE
		23 01 00 00 00 00 02 87 01
		23 01 00 00 00 00 02 88 3C
		23 01 00 00 00 00 02 89 01
		23 01 00 00 00 00 02 8A 6C
		23 01 00 00 00 00 02 8B 01
		23 01 00 00 00 00 02 8C B5
		23 01 00 00 00 00 02 8D 01
		23 01 00 00 00 00 02 8E EF
		23 01 00 00 00 00 02 8F 01
		23 01 00 00 00 00 02 90 F1
		23 01 00 00 00 00 02 91 02
		23 01 00 00 00 00 02 92 29
		23 01 00 00 00 00 02 93 02
		23 01 00 00 00 00 02 94 6C
		23 01 00 00 00 00 02 95 02
		23 01 00 00 00 00 02 96 99
		23 01 00 00 00 00 02 97 02
		23 01 00 00 00 00 02 98 D9
		23 01 00 00 00 00 02 99 02
		23 01 00 00 00 00 02 9A FC
		23 01 00 00 00 00 02 9B 03
		23 01 00 00 00 00 02 9C 2F
		23 01 00 00 00 00 02 9D 03
		23 01 00 00 00 00 02 9E 41
		23 01 00 00 00 00 02 9F 03
		23 01 00 00 00 00 02 A0 53
		23 01 00 00 00 00 02 A2 03
		23 01 00 00 00 00 02 A3 66
		23 01 00 00 00 00 02 A4 03
		23 01 00 00 00 00 02 A5 7A
		23 01 00 00 00 00 02 A6 03
		23 01 00 00 00 00 02 A7 90
		23 01 00 00 00 00 02 A9 03
		23 01 00 00 00 00 02 AA A9
		23 01 00 00 00 00 02 AB 03
		23 01 00 00 00 00 02 AC C7
		23 01 00 00 00 00 02 AD 03
		23 01 00 00 00 00 02 AE D3
		23 01 00 00 00 00 02 AF 00
		23 01 00 00 00 00 02 B0 00
		23 01 00 00 00 00 02 B1 00
		23 01 00 00 00 00 02 B2 0F
		23 01 00 00 00 00 02 B3 00
		23 01 00 00 00 00 02 B4 2B
		23 01 00 00 00 00 02 B5 00
		23 01 00 00 00 00 02 B6 44
		23 01 00 00 00 00 02 B7 00
		23 01 00 00 00 00 02 B8 5A
		23 01 00 00 00 00 02 B9 00
		23 01 00 00 00 00 02 BA 6F
		23 01 00 00 00 00 02 BB 00
		23 01 00 00 00 00 02 BC 81
		23 01 00 00 00 00 02 BD 00
		23 01 00 00 00 00 02 BE 92
		23 01 00 00 00 00 02 BF 00
		23 01 00 00 00 00 02 C0 A2
		23 01 00 00 00 00 02 C1 00
		23 01 00 00 00 00 02 C2 D5
		23 01 00 00 00 00 02 C3 00
		23 01 00 00 00 00 02 C4 FE
		23 01 00 00 00 00 02 C5 01
		23 01 00 00 00 00 02 C6 3C
		23 01 00 00 00 00 02 C7 01
		23 01 00 00 00 00 02 C8 6C
		23 01 00 00 00 00 02 C9 01
		23 01 00 00 00 00 02 CA B5
		23 01 00 00 00 00 02 CB 01
		23 01 00 00 00 00 02 CC EF
		23 01 00 00 00 00 02 CD 01
		23 01 00 00 00 00 02 CE F1
		23 01 00 00 00 00 02 CF 02
		23 01 00 00 00 00 02 D0 29
		23 01 00 00 00 00 02 D1 02
		23 01 00 00 00 00 02 D2 6C
		23 01 00 00 00 00 02 D3 02
		23 01 00 00 00 00 02 D4 99
		23 01 00 00 00 00 02 D5 02
		23 01 00 00 00 00 02 D6 D9
		23 01 00 00 00 00 02 D7 02
		23 01 00 00 00 00 02 D8 FC
		23 01 00 00 00 00 02 D9 03
		23 01 00 00 00 00 02 DA 2F
		23 01 00 00 00 00 02 DB 03
		23 01 00 00 00 00 02 DC 41
		23 01 00 00 00 00 02 DD 03
		23 01 00 00 00 00 02 DE 53
		23 01 00 00 00 00 02 DF 03
		23 01 00 00 00 00 02 E0 66
		23 01 00 00 00 00 02 E1 03
		23 01 00 00 00 00 02 E2 7A
		23 01 00 00 00 00 02 E3 03
		23 01 00 00 00 00 02 E4 90
		23 01 00 00 00 00 02 E5 03
		23 01 00 00 00 00 02 E6 A9
		23 01 00 00 00 00 02 E7 03
		23 01 00 00 00 00 02 E8 C7
		23 01 00 00 00 00 02 E9 03
		23 01 00 00 00 00 02 EA D3
		23 01 00 00 00 00 02 FF 24
		23 01 00 00 00 00 02 FB 01
		23 01 00 00 00 00 02 00 00
		23 01 00 00 00 00 02 01 01
		23 01 00 00 00 00 02 02 0B
		23 01 00 00 00 00 02 03 0C
		23 01 00 00 00 00 02 04 00
		23 01 00 00 00 00 02 05 03
		23 01 00 00 00 00 02 06 00
		23 01 00 00 00 00 02 07 04
		23 01 00 00 00 00 02 08 00
		23 01 00 00 00 00 02 09 00
		23 01 00 00 00 00 02 0A 00
		23 01 00 00 00 00 02 0B 00
		23 01 00 00 00 00 02 0C 00
		23 01 00 00 00 00 02 0D 17
		23 01 00 00 00 00 02 0E 15
		23 01 00 00 00 00 02 0F 13
		23 01 00 00 00 00 02 10 00
		23 01 00 00 00 00 02 11 01
		23 01 00 00 00 00 02 12 0B
		23 01 00 00 00 00 02 13 0C
		23 01 00 00 00 00 02 14 00
		23 01 00 00 00 00 02 15 03
		23 01 00 00 00 00 02 16 00
		23 01 00 00 00 00 02 17 04
		23 01 00 00 00 00 02 18 00
		23 01 00 00 00 00 02 19 00
		23 01 00 00 00 00 02 1A 00
		23 01 00 00 00 00 02 1B 00
		23 01 00 00 00 00 02 1C 00
		23 01 00 00 00 00 02 1D 17
		23 01 00 00 00 00 02 1E 15
		23 01 00 00 00 00 02 1F 13
		23 01 00 00 00 00 02 20 09
		23 01 00 00 00 00 02 21 02
		23 01 00 00 00 00 02 22 00
		23 01 00 00 00 00 02 23 02
		23 01 00 00 00 00 02 24 0A
		23 01 00 00 00 00 02 25 3D
		23 01 00 00 00 00 02 26 02
		23 01 00 00 00 00 02 27 0A
		23 01 00 00 00 00 02 28 38
		23 01 00 00 00 00 02 29 2B
		23 01 00 00 00 00 02 2F 02
		23 01 00 00 00 00 02 30 01
		23 01 00 00 00 00 02 31 49
		23 01 00 00 00 00 02 32 23
		23 01 00 00 00 00 02 33 01
		23 01 00 00 00 00 02 34 03
		23 01 00 00 00 00 02 35 6D
		23 01 00 00 00 00 02 36 00
		23 01 00 00 00 00 02 37 2D
		23 01 00 00 00 00 02 38 08
		23 01 00 00 00 00 02 39 03
		23 01 00 00 00 00 02 3A 6D
		23 01 00 00 00 00 02 3B 23
		23 01 00 00 00 00 02 74 04
		23 01 00 00 00 00 02 75 1F
		23 01 00 00 00 00 02 76 03
		23 01 00 00 00 00 02 77 01
		23 01 00 00 00 00 02 78 00
		23 01 00 00 00 00 02 79 00
		23 01 00 00 00 00 02 7A 00
		23 01 00 00 00 00 02 7B A2
		23 01 00 00 00 00 02 7C D8
		23 01 00 00 00 00 02 7D 50
		23 01 00 00 00 00 02 7E 04
		23 01 00 00 00 00 02 7F 1F
		23 01 00 00 00 00 02 80 00
		23 01 00 00 00 00 02 81 03
		23 01 00 00 00 00 02 82 01
		23 01 00 00 00 00 02 83 00
		23 01 00 00 00 00 02 84 03
		23 01 00 00 00 00 02 85 02
		23 01 00 00 00 00 02 86 5B
		23 01 00 00 00 00 02 87 39
		23 01 00 00 00 00 02 88 1B
		23 01 00 00 00 00 02 89 39
		23 01 00 00 00 00 02 8A FF
		23 01 00 00 00 00 02 8B F4
		23 01 00 00 00 00 02 8C 01
		23 01 00 00 00 00 02 9B FF
		23 01 00 00 00 00 02 9D 30
		23 01 00 00 00 00 02 72 00
		23 01 00 00 00 00 02 73 00
		23 01 00 00 00 00 02 90 72
		23 01 00 00 00 00 02 91 40
		23 01 00 00 00 00 02 92 72
		23 01 00 00 00 00 02 93 04
		23 01 00 00 00 00 02 94 04
		23 01 00 00 00 00 02 95 FF
		23 01 00 00 00 00 02 97 00
		23 01 00 00 00 00 02 B9 02
		23 01 00 00 00 00 02 BA 82
		23 01 00 00 00 00 02 C4 24
		23 01 00 00 00 00 02 C5 3A
		23 01 00 00 00 00 02 C6 09
		23 01 00 00 00 00 02 FF 2E
		23 01 00 00 00 00 02 FB 01
		23 01 00 00 00 00 02 00 29
		23 01 00 00 00 00 02 01 30
		23 01 00 00 00 00 02 02 17
		23 01 00 00 00 00 02 03 0c
		23 01 00 00 00 00 02 04 01
		23 01 00 00 00 00 02 05 25
		23 01 00 00 00 00 02 06 30
		23 01 00 00 00 00 02 07 06
		23 01 00 00 00 00 02 08 88
		23 01 00 00 00 00 02 09 C8
		23 01 00 00 00 00 02 0A 00
		23 01 00 00 00 00 02 F3 91
		23 01 00 00 00 00 02 0B 0C
		23 01 00 00 00 00 02 0C 6C
		23 01 00 00 00 00 02 0D 1F
		23 01 00 00 00 00 02 0E 1E
		23 01 00 00 00 00 02 0F 01
		23 01 00 00 00 00 02 10 05
		23 01 00 00 00 00 02 11 00
		23 01 00 00 00 00 02 13 0B
		23 01 00 00 00 00 02 14 10
		23 01 00 00 00 00 02 15 01
		23 01 00 00 00 00 02 16 00
		23 01 00 00 00 00 02 17 00
		23 01 00 00 00 00 02 18 42
		23 01 00 00 00 00 02 19 00
		23 01 00 00 00 00 02 1A 21
		23 01 00 00 00 00 02 1B 00
		23 01 00 00 00 00 02 1C 11
		23 01 00 00 00 00 02 1D 9B
		23 01 00 00 00 00 02 1E 1D
		23 01 00 00 00 00 02 1F 21
		23 01 00 00 00 00 02 20 3E
		23 01 00 00 00 00 02 21 00
		23 01 00 00 00 00 02 22 00
		23 01 00 00 00 00 02 23 00
		23 01 00 00 00 00 02 24 00
		23 01 00 00 00 00 02 25 00
		23 01 00 00 00 00 02 26 00
		23 01 00 00 00 00 02 27 00
		23 01 00 00 00 00 02 28 00
		23 01 00 00 00 00 02 29 00
		23 01 00 00 00 00 02 2A 00
		23 01 00 00 00 00 02 2B B0
		23 01 00 00 00 00 02 2D 3F
		23 01 00 00 00 00 02 2F 1D
		23 01 00 00 00 00 02 30 20
		23 01 00 00 00 00 02 31 3B
		23 01 00 00 00 00 02 32 30
		23 01 00 00 00 00 02 33 85
		23 01 00 00 00 00 02 34 01
		23 01 00 00 00 00 02 35 00
		23 01 00 00 00 00 02 36 00
		23 01 00 00 00 00 02 37 0C
		23 01 00 00 00 00 02 38 00
		23 01 00 00 00 00 02 39 00
		23 01 00 00 00 00 02 3A 00
		23 01 00 00 00 00 02 3B 80
		23 01 00 00 00 00 02 3D 03
		23 01 00 00 00 00 02 3F 57
		23 01 00 00 00 00 02 40 18
		23 01 00 00 00 00 02 41 06
		23 01 00 00 00 00 02 42 12
		23 01 00 00 00 00 02 43 11
		23 01 00 00 00 00 02 44 11
		23 01 00 00 00 00 02 45 11
		23 01 00 00 00 00 02 46 11
		23 01 00 00 00 00 02 47 11
		23 01 00 00 00 00 02 48 11
		23 01 00 00 00 00 02 4A 40
		23 01 00 00 00 00 02 4B 21
		23 01 00 00 00 00 02 4C 00
		23 01 00 00 00 00 02 4D 17
		23 01 00 00 00 00 02 4E 30
		23 01 00 00 00 00 02 4F 85
		23 01 00 00 00 00 02 50 02
		23 01 00 00 00 00 02 51 1D
		23 01 00 00 00 00 02 52 00
		23 01 00 00 00 00 02 53 00
		23 01 00 00 00 00 02 54 03
		23 01 00 00 00 00 02 55 00
		23 01 00 00 00 00 02 56 00
		23 01 00 00 00 00 02 58 00
		23 01 00 00 00 00 02 59 00
		23 01 00 00 00 00 02 5A 00
		23 01 00 00 00 00 02 5B 00
		23 01 00 00 00 00 02 5C 00
		23 01 00 00 00 00 02 5D 00
		23 01 00 00 00 00 02 5E 00
		23 01 00 00 00 00 02 5F 20
		23 01 00 00 00 00 02 60 1F
		23 01 00 00 00 00 02 61 3A
		23 01 00 00 00 00 02 62 40
		23 01 00 00 00 00 02 63 3B
		23 01 00 00 00 00 02 64 20
		23 01 00 00 00 00 02 65 30
		23 01 00 00 00 00 02 66 01
		23 01 00 00 00 00 02 67 00
		23 01 00 00 00 00 02 68 00
		23 01 00 00 00 00 02 69 00
		23 01 00 00 00 00 02 6B 80
		23 01 00 00 00 00 02 6C 57
		23 01 00 00 00 00 02 6D 18
		23 01 00 00 00 00 02 6E 0C
		23 01 00 00 00 00 02 6F 05
		23 01 00 00 00 00 02 70 11
		23 01 00 00 00 00 02 71 11
		23 01 00 00 00 00 02 72 11
		23 01 00 00 00 00 02 73 11
		23 01 00 00 00 00 02 74 11
		23 01 00 00 00 00 02 75 11
		23 01 00 00 00 00 02 76 00
		23 01 00 00 00 00 02 77 40
		23 01 00 00 00 00 02 D2 00
		23 01 00 00 00 00 02 D3 00
		23 01 00 00 00 00 02 D4 00
		23 01 00 00 00 00 02 D5 00
		23 01 00 00 00 00 02 D6 30
		23 01 00 00 00 00 02 D7 30
		23 01 00 00 00 00 02 D8 30
		23 01 00 00 00 00 02 D9 30
		23 01 00 00 00 00 02 DB 00
		23 01 00 00 00 00 02 E3 01
		23 01 00 00 00 00 02 E4 20
		23 01 00 00 00 00 02 E5 00
		23 01 00 00 00 00 02 E6 06
		23 01 00 00 00 00 02 E7 05
		23 01 00 00 00 00 02 E8 05
		23 01 00 00 00 00 02 E9 03
		23 01 00 00 00 00 02 EA 02
		23 01 00 00 00 00 02 EB 05
		23 01 00 00 00 00 02 EC 00
		23 01 00 00 00 00 02 ED 5E
		23 01 00 00 00 00 02 EE 10
		23 01 00 00 00 00 02 EF 82
		23 01 00 00 00 00 02 F0 12
		23 01 00 00 00 00 02 F1 70
		23 01 00 00 00 00 02 FF 2F
		23 01 00 00 00 00 02 FB 01
		23 01 00 00 00 00 02 00 00
		23 01 00 00 00 00 02 01 00
		23 01 00 00 00 00 02 02 00
		23 01 00 00 00 00 02 03 00
		23 01 00 00 00 00 02 06 00
		23 01 00 00 00 00 02 08 00
		23 01 00 00 00 00 02 0A 00
		23 01 00 00 00 00 02 0B 00
		23 01 00 00 00 00 02 04 07
		23 01 00 00 00 00 02 05 06
		23 01 00 00 00 00 02 07 02
		23 01 00 00 00 00 02 09 0B
		23 01 00 00 00 00 02 0D 00
		23 01 00 00 00 00 02 0E 00
		23 01 00 00 00 00 02 12 00
		23 01 00 00 00 00 02 0C 0B
		23 01 00 00 00 00 02 0F 02
		23 01 00 00 00 00 02 10 06
		23 01 00 00 00 00 02 11 07
		23 01 00 00 00 00 02 13 00
		23 01 00 00 00 00 02 14 44
		23 01 00 00 00 00 02 15 00
		23 01 00 00 00 00 02 16 80
		23 01 00 00 00 00 02 17 80
		23 01 00 00 00 00 02 18 40
		23 01 00 00 00 00 02 19 40
		23 01 00 00 00 00 02 1A 40
		23 01 00 00 00 00 02 1B 40
		23 01 00 00 00 00 02 1C 40
		23 01 00 00 00 00 02 1D 40
		23 01 00 00 00 00 02 1E 40
		23 01 00 00 00 00 02 1F E1
		23 01 00 00 00 00 02 20 E1
		23 01 00 00 00 00 02 21 5A
		23 01 00 00 00 00 02 22 92
		23 01 00 00 00 00 02 23 92
		23 01 00 00 00 00 02 24 8B
		23 01 00 00 00 00 02 25 8B
		23 01 00 00 00 00 02 26 0A
		23 01 00 00 00 00 02 31 00
		23 01 00 00 00 00 02 32 55
		23 01 00 00 00 00 02 43 01
		23 01 00 00 00 00 02 7A 00
		23 01 00 00 00 00 02 7B 25
		23 01 00 00 00 00 02 FF 23
		23 01 00 00 00 00 02 FB 01
		23 01 00 00 00 00 02 01 84
		23 01 00 00 00 00 02 05 22
		23 01 00 00 00 00 02 06 06
		23 01 00 00 00 00 02 08 06

		23 01 00 00 00 00 02 FF 22
		23 01 00 00 00 00 02 00 00
		23 01 00 00 00 00 02 01 00
		23 01 00 00 00 00 02 02 00
		23 01 00 00 00 00 02 03 00
		23 01 00 00 00 00 02 04 00
		23 01 00 00 00 00 02 05 00
		23 01 00 00 00 00 02 06 00
		23 01 00 00 00 00 02 07 00
		23 01 00 00 00 00 02 08 00
		23 01 00 00 00 00 02 09 00
		23 01 00 00 00 00 02 0A 00
		23 01 00 00 00 00 02 0B 00
		23 01 00 00 00 00 02 0C 23
		23 01 00 00 00 00 02 0D 46
		23 01 00 00 00 00 02 0E 5E
		23 01 00 00 00 00 02 0F 7C
		23 01 00 00 00 00 02 10 7C
		23 01 00 00 00 00 02 11 97
		23 01 00 00 00 00 02 12 46
		23 01 00 00 00 00 02 13 23
		23 01 00 00 00 00 02 1A 00
		23 01 00 00 00 00 02 1B 00
		23 01 00 00 00 00 02 1C 00
		23 01 00 00 00 00 02 1D 00
		23 01 00 00 00 00 02 1E 00
		23 01 00 00 00 00 02 1F 00
		23 01 00 00 00 00 02 20 00
		23 01 00 00 00 00 02 21 00
		23 01 00 00 00 00 02 22 00
		23 01 00 00 00 00 02 23 00
		23 01 00 00 00 00 02 24 00
		23 01 00 00 00 00 02 25 00
		23 01 00 00 00 00 02 26 00
		23 01 00 00 00 00 02 27 00
		23 01 00 00 00 00 02 28 00
		23 01 00 00 00 00 02 29 00
		23 01 00 00 00 00 02 2A 00
		23 01 00 00 00 00 02 2B 00
		23 01 00 00 00 00 02 2F 00
		23 01 00 00 00 00 02 30 00
		23 01 00 00 00 00 02 31 00
		23 01 00 00 00 00 02 32 0D
		23 01 00 00 00 00 02 33 14
		23 01 00 00 00 00 02 34 0D
		23 01 00 00 00 00 02 35 07
		23 01 00 00 00 00 02 36 00
		23 01 00 00 00 00 02 37 00
		23 01 00 00 00 00 02 38 00
		23 01 00 00 00 00 02 39 00
		23 01 00 00 00 00 02 3A 00
		23 01 00 00 00 00 02 3B 00
		23 01 00 00 00 00 02 3F 00
		23 01 00 00 00 00 02 40 00
		23 01 00 00 00 00 02 41 00
		23 01 00 00 00 00 02 42 00
		23 01 00 00 00 00 02 43 00
		23 01 00 00 00 00 02 44 00
		23 01 00 00 00 00 02 45 00
		23 01 00 00 00 00 02 46 00
		23 01 00 00 00 00 02 47 00
		23 01 00 00 00 00 02 48 00
		23 01 00 00 00 00 02 49 00
		23 01 00 00 00 00 02 4A 00
		23 01 00 00 00 00 02 4B 00
		23 01 00 00 00 00 02 4C 07
		23 01 00 00 00 00 02 4D 00
		23 01 00 00 00 00 02 4E 00
		23 01 00 00 00 00 02 4F 00
		23 01 00 00 00 00 02 50 00
		23 01 00 00 00 00 02 51 00
		23 01 00 00 00 00 02 52 00
		23 01 00 00 00 00 02 53 01
		23 01 00 00 00 00 02 54 00
		23 01 00 00 00 00 02 55 88
		23 01 00 00 00 00 02 56 00
		23 01 00 00 00 00 02 58 00
		23 01 00 00 00 00 02 68 00
		23 01 00 00 00 00 02 84 00
		23 01 00 00 00 00 02 85 00
		23 01 00 00 00 00 02 86 00
		23 01 00 00 00 00 02 87 00
		23 01 00 00 00 00 02 88 00
		23 01 00 00 00 00 02 A2 20
		23 01 00 00 00 00 02 A9 00
		23 01 00 00 00 00 02 FB 01

		23 01 00 00 00 00 02 FF 23
		23 01 00 00 00 00 02 FB 01
		23 01 00 00 00 00 02 00 20
		23 01 00 00 00 00 02 07 00
		23 01 00 00 00 00 02 08 01
		23 01 00 00 00 00 02 46 00

		23 01 00 00 00 00 02 FF 10
		23 01 00 00 00 00 02 FB 01
		39 01 00 00 00 00 06 3B 03 08 08 0A 0A
		23 01 00 00 00 00 02 35 00
		23 01 00 00 00 00 02 B0 01
		39 01 00 00 00 00 03 51 00 00
		23 01 00 00 00 00 02 55 83
		39 01 00 00 00 00 03 68 04 01
		05 01 00 00 78 00 02 11 00
		05 01 00 00 00 00 02 29 00
];

		qcom,mdss-dsi-off-command = [
		23 01 00 00 00 00 02 FF 20
		23 01 00 00 00 00 02 FB 01
		23 01 00 00 00 00 02 B1 03
		23 01 00 00 00 00 02 B2 FF
		23 01 00 00 00 00 02 ED 03
		23 01 00 00 00 00 02 EE FF

		23 01 00 00 00 00 02 FF 21
		23 01 00 00 00 00 02 FB 01
		23 01 00 00 00 00 02 30 03
		23 01 00 00 00 00 02 31 FF
		23 01 00 00 00 00 02 6F 03
		23 01 00 00 00 00 02 70 FF

		23 01 00 00 00 00 02 AD 03
		23 01 00 00 00 00 02 AE FF
		23 01 00 00 00 00 02 E9 03
		23 01 00 00 00 00 02 EA FF

		23 01 00 00 00 00 02 FF 10
		05 01 00 00 14 00 02 28 00
		05 01 00 00 78 00 02 10 00];
		qcom,mdss-dsi-on-command-state = "dsi_lp_mode";
		qcom,mdss-dsi-off-command-state = "dsi_hs_mode";
		qcom,mdss-pan-physical-width-dimension = <69>;
		qcom,mdss-pan-physical-height-dimension = <122>;
		qcom,mdss-dsi-h-sync-pulse = <1>;
		qcom,mdss-dsi-traffic-mode = "burst_mode";
		qcom,mdss-dsi-lane-map = "lane_map_0123";
		qcom,mdss-dsi-bllp-eof-power-mode;
		qcom,mdss-dsi-bllp-power-mode;
		qcom,mdss-dsi-lp11-init;
		qcom,mdss-dsi-init-delay-us = <5>;
		qcom,mdss-dsi-lane-0-state;
		qcom,mdss-dsi-lane-1-state;
		qcom,mdss-dsi-lane-2-state;
		qcom,mdss-dsi-lane-3-state;
		qcom,mdss-dsi-te-pin-select = <1>;
		qcom,mdss-dsi-wr-mem-start = <0x2c>;
		qcom,mdss-dsi-te-dcs-command = <1>;
		qcom,mdss-dsi-te-check-enable;
		qcom,mdss-dsi-te-using-te-pin;
		//qcom,mdss-dsi-panel-timings = [E6 38 26 00 68 6E 2A 3C 2C 03 04 00];
		//qcom,mdss-dsi-t-clk-post = <0x2c>;
		//qcom,mdss-dsi-t-clk-pre = <0x2b>;
		qcom,mdss-dsi-panel-timings = [D5 32 22 00 60 64 26 36 29 03 04 00];
		qcom,mdss-dsi-t-clk-post = <0x2c>;
		qcom,mdss-dsi-t-clk-pre = <0x2b>;
		//qcom,esd-check-enabled;
		qcom,mdss-dsi-panel-status-command = [06 01 00 01 05 00 01 0A];
		qcom,mdss-dsi-panel-status-command-state = "dsi_hs_mode";
		qcom,mdss-dsi-panel-status-check-mode = "reg_read";
		qcom,mdss-dsi-panel-status-read-length=<1>;
		qcom,mdss-dsi-panel-status-value = <0x9C>;
		qcom,mdss-dsi-bl-pmic-pwm-frequency = <100>;
		qcom,mdss-dsi-bl-pmic-bank-select = <0>;
		qcom,mdss-dsi-dma-trigger = "trigger_sw";
		qcom,mdss-dsi-mdp-trigger = "none";
		qcom,mdss-dsi-bl-pmic-control-type = "bl_ctrl_dcs";
		qcom,mdss-dsi-bl-min-level = <0>;
		qcom,mdss-dsi-bl-max-level = <4095>;
		qcom,mdss-dsi-reset-sequence = <1 10>, <0 10>, <1 10>;
		qcom,mdss-dsi-post-init-delay = <5>;
	};
};
