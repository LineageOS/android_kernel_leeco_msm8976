## arch/arm64/product_list/Kconfig
```kconfig
#Date			Author			Why					jira
#========================================================
#==========QL1530 CONFIG BEGIN===========================
config PRODUCT_S2
	depends on ARCH_MSM8916
	bool "PRODUCT_S2 Support"
	help
	  Fix version type as PRODUCT_S2
```

## drivers/input/fingerprint/goodix/Kconfig
```kconfig
config GOODIX_FP
	tristate "Goodix GFX18M fingerprint drvier support"
	help
	  Say Y here to enable goodix fingerprint driver support!
```

## drivers/input/touchscreen/synaptics_dsx_oem/Kconfig
```kconfig
#
# Synaptics DSX touchscreen driver configuration
#
menuconfig TOUCHSCREEN_SYNAPTICS_DSX_OEM
	bool "Synaptics DSX touchscreen"
	default y
	help
	  Say Y here if you have a Synaptics DSX touchscreen connected
	  to your system.

	  If unsure, say N.

if TOUCHSCREEN_SYNAPTICS_DSX_OEM

choice
	default TOUCHSCREEN_SYNAPTICS_DSX_OEM_I2C
	prompt "Synaptics DSX bus interface"
config TOUCHSCREEN_SYNAPTICS_DSX_OEM_I2C
	bool "I2C"
	depends on I2C
	help
	  Say Y here if you have a Synaptics DSX touchscreen interfaced
	  to the host processor over I2C

	  If unsure, say N.

	  This module uses the services of DSX CORE
config TOUCHSCREEN_SYNAPTICS_DSX_OEM_SPI
	bool "SPI"
	depends on SPI_MASTER
	help
	  Say Y here if you have a Synaptics DSX touchscreen interfaced
	  to the host processor over SPI

	  If unsure, say N.

	  This module uses the services of DSX CORE
endchoice

config TOUCHSCREEN_SYNAPTICS_DSX_OEM_CORE
	tristate "Synaptics DSX core driver module"
	depends on I2C || SPI_MASTER
	help
	  Say Y here to enable basic touch reporting functionality.

	  If unsure, say N.

	  To compile this driver as a module, choose M here: the
	  module will be called synaptics_dsx_core.
config TOUCHSCREEN_DEBUG_INFO
	tristate "Touchscreen Debug info Driver"
	help
	  Say Y here if you want to generate a sysfs entry for debug
	  log info on Android.

	  If unsure, say N.

	  To compile this driver as a module, choose M here: the
	  module will be called Debug_info.
config TOUCHSCREEN_SYNAPTICS_DSX_OEM_RMI_DEV
	tristate "Synaptics DSX RMI device module"
	depends on TOUCHSCREEN_SYNAPTICS_DSX_OEM_CORE
	help
	  Say Y here to enable support for direct RMI register access.

	  If unsure, say N.

	  To compile this driver as a module, choose M here: the
	  module will be called synaptics_dsx_rmi_dev.

config TOUCHSCREEN_SYNAPTICS_DSX_OEM_FW_UPDATE
	tristate "Synaptics DSX firmware update module"
	depends on TOUCHSCREEN_SYNAPTICS_DSX_OEM_CORE
	help
	  Say Y here to enable support for doing firmware update.

	  If unsure, say N.

	  To compile this driver as a module, choose M here: the
	  module will be called synaptics_dsx_fw_update.

config TOUCHSCREEN_SYNAPTICS_DSX_OEM_TEST_REPORTING
	tristate "Synaptics DSX test reporting module"
	depends on TOUCHSCREEN_SYNAPTICS_DSX_OEM_CORE
	help
	  Say Y here to enable support for retrieving production test reports.

	  If unsure, say N.

	  To compile this driver as a module, choose M here: the
	  module will be called synaptics_dsx_test_reporting.

config TOUCHSCREEN_SYNAPTICS_DSX_OEM_PROXIMITY
	tristate "Synaptics DSX proximity module"
	depends on TOUCHSCREEN_SYNAPTICS_DSX_OEM_CORE
	help
	  Say Y here to enable support for proximity functionality.

	  If unsure, say N.

	  To compile this driver as a module, choose M here: the
	  module will be called synaptics_dsx_proximity.

config TOUCHSCREEN_SYNAPTICS_DSX_OEM_ACTIVE_PEN
	tristate "Synaptics DSX active pen module"
	depends on TOUCHSCREEN_SYNAPTICS_DSX_OEM_CORE
	help
	  Say Y here to enable support for active pen functionality.

	  If unsure, say N.

	  To compile this driver as a module, choose M here: the
	  module will be called synaptics_dsx_active_pen.

config TOUCHSCREEN_SYNAPTICS_DSX_OEM_GESTURE
	tristate "Synaptics DSX user defined gesture module"
	depends on TOUCHSCREEN_SYNAPTICS_DSX_OEM_CORE
	help
	  Say Y here to enable support for user defined gesture functionality.

	  If unsure, say N.

	  To compile this driver as a module, choose M here: the
	  module will be called synaptics_dsx_gesture.

config TOUCHSCREEN_SYNAPTICS_DSX_OEM_VIDEO
	tristate "Synaptics DSX video module"
	depends on TOUCHSCREEN_SYNAPTICS_DSX_OEM_CORE
	help
	  Say Y here to enable support for video communication functionality.

	  If unsure, say N.

	  To compile this driver as a module, choose M here: the
	  module will be called synaptics_dsx_video.

endif
```

## drivers/misc/type-c-leeco/Kconfig
```kconfig
config USB_TYPE_C_LEECO
	bool "Enable LeEco type-c support"
	---help---
	Enables LeEco specific type-c driver support

config TYPE_C_INFO
	tristate "get usb type-c info"
	depends on USB_TYPE_C_LEECO
	default n
	help
	  get the usb type-c info, provide kernel node interface.

config USB_EXT_TYPE_C_TI_LEECO
	tristate "USB Type-C charger detection support using TI chip"
	depends on I2C && POWER_SUPPLY && USB_TYPE_C_LEECO
	help
	  Enables support for the USB Type-C chargers using external
	  TI chip connected using I2C.

	  This adds support for detecting USB Type-C chargers that
	  can supply upto 3A Vbus current for charging.

config USB_EXT_TYPE_C_NXP_LEECO
	tristate "USB Type-C charger detection support using NXP chip"
	depends on I2C && POWER_SUPPLY && USB_TYPE_C_LEECO
	help
	  Enables support for the USB Type-C chargers using external
	  NXP chip connected using I2C.

	  This adds support for detecting USB Type-C chargers that
	  can supply upto 3A Vbus current for charging.
```

## drivers/staging/product_config/Kconfig
```kconfig
config PRODUCT_S2
	depends on ARCH_MSM8916
	bool "PRODUCT_S2 Support"
	default n
	---help---
	  Fix version type as PRODUCT_S2
```
